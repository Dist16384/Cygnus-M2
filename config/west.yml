## config/west.yml
```yaml
manifest:
  remotes:
    - name: zmkfirmware
      url-base: https://github.com/zmkfirmware
    - name: sayu-hub  # pmw3610-driver のフォーク
      url-base: https://github.com/sayu-hub
    - name: badjeff  # PMW3610 driver for ZMK v0.3
      url-base: https://github.com/badjeff
    - name: caksoylar  # <-- RGB LED
      url-base: https://github.com/caksoylar  

  projects:
    - name: zmk
      remote: zmkfirmware
      revision: v0.3
      path: zmk
      import: app/west.yml
    - name: zmk-pmw3610-driver
      remote: badjeff
      # Pin the zmk-0.3 branch revision; main targets a newer ZMK/Zephyr API.
      revision: 5c5af40de4d8cdf55dc63c4c5907af1e52da6a95
      path: modules/zmk-pmw3610-driver
    - name: zmk-rgbled-widget
      remote: caksoylar
      revision: v0.3

  self:
    path: config
```
